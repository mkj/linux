## Documentation/devicetree/bindings/arm/npcm/npcm.txt
```
NPCM Platforms Device Tree Bindings
-----------------------------------
NPCM750 SoC
Required root node properties:
	- compatible = "nuvoton,npcm750";
NPCM845 SoC
Required root node properties:
	- compatible = "nuvoton,npcm845";
```

## Documentation/devicetree/bindings/i3c/npcm8xx,i3c-master.txt
```
Bindings for npcm8xx I3C master block
=====================================

Required properties:
--------------------
- compatible: shall be "nuvoton,npcm845-i3c"
- clocks: shall reference the i3c module_clk and mclk
- clock-names: shall contain "pclk" and "fast_clk"
- interrupts: the interrupt line connected to this I3C master
- reg: Offset and length of I3C master registers
- pinctrl-names : a pinctrl state named "default" must be defined.
- pinctrl-0 : phandle referencing pin configuration of the controller.

Mandatory properties defined by the generic binding (see
Documentation/devicetree/bindings/i3c/i3c.txt for more details):

- #address-cells: shall be set to 3
- #size-cells: shall be set to 0

Optional properties defined by the generic binding (see
Documentation/devicetree/bindings/i3c/i3c.txt for more details):

- i2c-scl-hz
- i3c-scl-hz

I3C device connected on the bus follow the generic description (see
Documentation/devicetree/bindings/i3c/i3c.txt for more details).

Example:

	i3c0: i3c@fff10000 {
		compatible = "nuvoton,npcm845-i3c";
		reg = <0xfff10000 0x1000>;
		pinctrl-names = "default";
		pinctrl-0 = <&i3c0_pins>;
		clocks = <&clk NPCM8XX_CLK_AHB>, <&clk NPCM8XX_CLK_RCP>;
		clock-names = "pclk", "fast_clk";
		interrupts = <GIC_SPI 224 IRQ_TYPE_LEVEL_HIGH>;
		#address-cells = <3>;
		#size-cells = <0>;
	};
```

## Documentation/devicetree/bindings/net/nuvoton,npcm7xx-emc.txt
```
Nuvoton NPCM7XX 10/100 Ethernet MAC Controller (EMC)

The NPCM7XX provides one or two Ethernet MAC RMII Controllers
for WAN/LAN applications

Required properties:
- device_type     : Should be "network"
- compatible      : "nuvoton,npcm750-emc" for Poleg NPCM7XX.
- reg             : Offset and length of the register set for the device.
- interrupts      : Contain the emc interrupts with flags for falling edge.
                    first interrupt dedicated to Txirq
                    second interrupt dedicated to Rxirq
- phy-mode        : Should be "rmii" (see ethernet.txt in the same directory)
- clocks          : phandle of emc reference clock.
- resets          : phandle to the reset control for this device.
- use-ncsi        : Use the NC-SI stack instead of an MDIO PHY

Example:

emc0: eth@f0825000 {
	device_type = "network";
	compatible = "nuvoton,npcm750-emc";
	reg = <0xf0825000 0x1000>;
	interrupts = <GIC_SPI 16 IRQ_TYPE_LEVEL_HIGH>,
	             <GIC_SPI 15 IRQ_TYPE_LEVEL_HIGH>;
	phy-mode = "rmii";
	clocks = <&clk NPCM7XX_CLK_AHB>;

	#use-ncsi; /* add this to support ncsi */

	clock-names = "clk_emc";
	resets = <&rstc NPCM7XX_RESET_IPSRST1 NPCM7XX_RESET_EMC1>;
	pinctrl-names = "default";
	pinctrl-0 = <&r1_pins
	             &r1err_pins
	             &r1md_pins>;
	status = "okay";
};
```

## Documentation/devicetree/bindings/pci/npcm-pcie.txt
```
* NPCM PCIe Root Complex description

Required properties:
- #address-cells: Address representation for root ports, set to <3>
- #size-cells: Size representation for root ports, set to <2>
- #interrupt-cells: specifies the number of cells needed to encode an
	interrupt source. The value must be 1.
- compatible: Should contain "nuvoton,npcm845-pcie"
- reg : the first contains the register location and length,
        the second contains the configuration window address and length
- device_type: must be "pci"
- resets : phandle to the reset control for this device.
- interrupts: contain PCIe interrupt.
- interrupt-map-mask,
  interrupt-map: standard PCIe properties to define the mapping of the
	PCI interface to interrupt numbers.
- ranges: ranges for the PCIe memory regions
	Please refer to the standard PCI bus binding document for a more
	detailed explanation

Optional properties:
- bus-range:	PCI bus numbers covered

NOTE:
The core provides a single interrupt for MSI messages. So,
created a interrupt controller node to support 'interrupt-map' DT
functionality.


Example:
++++++++
	pcie: pcie@e1000000 {
		compatible = "nuvoton,npcm845-pcie";
		device_type = "pci";
		reg = <0x0 0xE1000000 0x0 0x1000>,
			<0x0 0xE8000000 0x0 0x1000>;	
		bus-range = <0x0 0xF>;
		#address-cells = <3>;
		#size-cells = <2>;
		#interrupt-cells = <1>;
 		ranges = <0x01000000 0 0xe9000000 0x0 0xe9000000 0 0x01000000 
			  0x02000000 0 0xea000000 0x0 0xea000000 0 0x04000000>;
		resets = <&rstc NPCM8XX_RESET_IPSRST4 NPCM8XX_RESET_PCIE_RC>;
		interrupts = <GIC_SPI 127 IRQ_TYPE_LEVEL_HIGH>;
		interrupt-map-mask = <0 0 0 7>;
		interrupt-map = <0 0 0 1 &gic GIC_SPI 127 IRQ_TYPE_LEVEL_HIGH>;
	};
```

## Documentation/devicetree/bindings/thermal/npcm-thermal.txt
```
NPCM Thermal

Required Properties:
- compatible : "nuvoton,npcm845-thermal"
- reg 	 	 : Address range of the thermal registers.
- clocks 	 : phandle of PSPI reference clock.
- interrupts : contain Thermal interrupt.
- #thermal-sensor-cells: must be 1.

Example for tempsensor:

	tmps: tmps@188000 {
		compatible = "nuvoton,npcm845-thermal";
		interrupts = <GIC_SPI 4 IRQ_TYPE_LEVEL_HIGH>;
		clocks = <&clk NPCM8XX_CLK_APB4>;
		reg = <0x188000 0x5C>;
		#thermal-sensor-cells = <1>;
	};

Example for thermal zones:

	thermal-zones {
		cpu0_thermal: cpu0-thermal {
			polling-delay-passive = <250>;
			polling-delay = <1000>;
			thermal-sensors = <&tmps 0>;
			trips {
				cpu0_alert0: trip-point0 {
					temperature = <90000>;
					hysteresis = <2000>;
					type = "passive";
				};
			};
		};
		cpu1_thermal: cpu1-thermal {
			polling-delay-passive = <250>;
			polling-delay = <1000>;
			thermal-sensors = <&tmps 1>;
			trips {
				cpu1_alert0: trip-point0 {
					temperature = <90000>;
					hysteresis = <2000>;
					type = "passive";
				};
			};
		};
	};
```

## Documentation/devicetree/bindings/timer/nuvoton,npcm7xx-timer.txt
```
Nuvoton NPCM timer

Nuvoton NPCM have three timer modules, each timer module provides five 24-bit
timer counters.

Required properties:
- compatible      : "nuvoton,npcm750-timer" for Poleg NPCM750.
				    "nuvoton,npcm845-timer" for Arbel NPCM845.
- reg             : Offset and length of the register set for the device.
- interrupts      : Contain the timer interrupt with flags for
                    falling edge.
- clocks          : phandle of timer reference clock (usually a 25 MHz clock).

Example:

timer@f0008000 {
    compatible = "nuvoton,npcm750-timer";
    interrupts = <GIC_SPI 32 IRQ_TYPE_LEVEL_HIGH>;
    reg = <0xf0008000 0x50>;
    clocks = <&clk NPCM7XX_CLK_TIMER>;
};
```

## Documentation/devicetree/bindings/watchdog/nuvoton,npcm-wdt.txt
```
Nuvoton NPCM Watchdog

Nuvoton NPCM timer module provides five 24-bit timer counters, and a watchdog.
The watchdog supports a pre-timeout interrupt that fires 10ms before the
expiry.

Required properties:
- compatible      : "nuvoton,npcm750-wdt" for NPCM750 (Poleg).
- reg             : Offset and length of the register set for the device.
- interrupts      : Contain the timer interrupt with flags for
                    falling edge.

Required clocking property, have to be one of:
- clocks          : phandle of timer reference clock.
- clock-frequency : The frequency in Hz of the clock that drives the NPCM7xx
                    timer (usually 25000000).

Optional properties:
- syscon: a phandle to access GCR registers.
- timeout-sec : Contains the watchdog timeout in seconds
- nuvoton,restart-priority - Contains the card restart priority.
- nuvoton,card-reset-type = "porst|corst|wd0|wd1|wd2|sw1|sw2|sw3|sw4"
  Contains the card reset type for checking and indicating
  the last card reset status (WDIOF_CARDRESET)

  If 'nuvoton,card-reset-type' is not specified the default is porst

  Reset types:
       - porst: Power reset
       - corst: Core reset
	   - wdX : Watchdog reset X (X represante 0-2)
	   - swX : Software reset X (X represante 1-4)

- nuvoton,ext1-reset-type = "porst|corst|wd0|wd1|wd2|sw1|sw2|sw3|sw4"
  Contains the external 2 reset type for checking and indicating
  the last external 2 reset status (WDIOF_EXTERN1)

  If 'nuvoton,card-reset-type' is not specified the default is wd0.

  Reset types are the same as in nuvoton,card-reset-type property.

- nuvoton,ext2-reset-type = "porst|corst|wd0|wd1|wd2|sw1|sw2|sw3|sw4"
  Contains the external 2 reset type for checking and indicating
  the last external 2 reset status (WDIOF_EXTERN2)

  If 'nuvoton,card-reset-type' is not specified the default is sw1.

  Reset types are the same as in nuvoton,card-reset-type property.

Example:

timer@f000801c {
    compatible = "nuvoton,npcm750-wdt";
    interrupts = <GIC_SPI 47 IRQ_TYPE_LEVEL_HIGH>;
    reg = <0xf000801c 0x4>;
    clocks = <&clk NPCM7XX_CLK_TIMER>;
	syscon = <&gcr>;
	nuvoton,restart-priority = <155>;
	nuvoton,card-reset-type = "porst";
	nuvoton,ext1-reset-type = "wd1";
	nuvoton,ext2-reset-type = "sw2";
};
```

## drivers/media/platform/nuvoton/Kconfig
```kconfig
config NPCM_VCD
	tristate "Nuvoton VCD support"
        help
          Enable Nuvoton vcd.

config NPCM_ECE
	tristate "Nuvoton ECE support"
	help
	  Enable Nuvoton Encoding and Compression Engine.
```
